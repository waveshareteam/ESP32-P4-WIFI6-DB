## components/waveshare_bmgr/Kconfig
```kconfig
menu "Waveshare LCD"

choice BSP_LCD_TYPE
    prompt "Select LCD type"
    default BSP_LCD_USE_BOARD_DEFAULT

config BSP_LCD_USE_BOARD_DEFAULT
    bool "Use LCD configuration from board YAML"
    help
        Use the LCD chip, timing, color format, reset GPIO, and other
        parameters provided by the selected board's Board Manager YAML.

config BSP_LCD_TYPE_800_800_3_4_INCH
    bool "Waveshare 3.4-DSI-TOUCH-C Display"

config BSP_LCD_TYPE_720_720_4_INCH
    bool "Waveshare 4-DSI-TOUCH-C Display"

config BSP_LCD_TYPE_480_800_4_INCH_A
    bool "Waveshare 4-DSI-TOUCH-A Display"

config BSP_LCD_TYPE_480_800_4_3_INCH_A
    bool "Waveshare 4.3-DSI-TOUCH-A Display"

config BSP_LCD_TYPE_720_1280_5_INCH_A
    bool "Waveshare 5-DSI-TOUCH-A Display"

config BSP_LCD_TYPE_720_1280_7_INCH_A
    bool "Waveshare 7-DSI-TOUCH-A Display"

config BSP_LCD_TYPE_1024_600_7_INCH_C
    bool "Waveshare 7-DSI-TOUCH-C Display"

config BSP_LCD_TYPE_800_1280_8_INCH_A
    bool "Waveshare 8-DSI-TOUCH-A Display"

config BSP_LCD_TYPE_480_1920_8_8_INCH_A
    bool "Waveshare 8.8-DSI-TOUCH-A Display"

config BSP_LCD_TYPE_720_1280_9_INCH_B
    bool "Waveshare 9-DSI-TOUCH-B Display"

config BSP_LCD_TYPE_800_1280_10_1_INCH_A
    bool "Waveshare 10.1-DSI-TOUCH-A Display"

config BSP_LCD_TYPE_720_1280_10_1_INCH_B
    bool "Waveshare 10.1-DSI-TOUCH-B Display"

endchoice

choice BSP_LCD_COLOR_FORMAT
    prompt "LCD color format"
    default BSP_LCD_COLOR_FORMAT_RGB565

config BSP_LCD_COLOR_FORMAT_RGB565
    bool "RGB565"

config BSP_LCD_COLOR_FORMAT_RGB888
    bool "RGB888"

endchoice

config BSP_LCD_DPI_BUFFER_NUMS
    int "MIPI DSI frame buffer count"
    default 3
    range 1 3
    help
        Number of full-screen frame buffers allocated by the MIPI DSI DPI panel.
        Multiple buffers enable tear avoidance and are required by the LVGL
        triple-buffer display path used by this project.

config BSP_LCD_TYPE_AMENDS
    bool "Enable LCD type amend overrides"
    default n
    help
        Enable the panel factory overrides supplied by the selected LCD amend.
        This is set by an LCD amend's sdkconfig.defaults.board file.

config BSP_LCD_BRIGHTNESS_USE_I2C
    bool "Use custom I2C LCD brightness controller"
    default y
    help
        Enable the custom LCD brightness device implemented with the I2C
        controller. Set this to n for an LCD amend that uses another
        backlight control method, and override the lcd_brightness device in
        that amend when a different Board Manager device type is required.

endmenu
```

## components/waveshare_bmgr/amends/lcd_5_dsi_touch_a/sdkconfig.defaults.board
```kconfig
CONFIG_BSP_LCD_TYPE_720_1280_5_INCH_A=y
CONFIG_BSP_LCD_COLOR_FORMAT_RGB565=y
CONFIG_BSP_LCD_DPI_BUFFER_NUMS=3
CONFIG_BSP_LCD_TYPE_AMENDS=y
```

## components/waveshare_bmgr/amends/lcd_8_dsi_touch_a/sdkconfig.defaults.board
```kconfig
CONFIG_BSP_LCD_TYPE_800_1280_8_INCH_A=y
CONFIG_BSP_LCD_COLOR_FORMAT_RGB565=y
CONFIG_BSP_LCD_DPI_BUFFER_NUMS=3
CONFIG_BSP_LCD_TYPE_AMENDS=y
```

## components/waveshare_bmgr/esp32_p4_wifi6_db/sdkconfig.defaults.board
```kconfig
CONFIG_ESPTOOLPY_FLASHMODE_QIO=y
CONFIG_ESPTOOLPY_FLASHFREQ_80M=y
CONFIG_ESPTOOLPY_FLASHSIZE_32MB=y
CONFIG_SPIRAM=y
CONFIG_SPIRAM_MODE_HEX=y
CONFIG_SPIRAM_SPEED_200M=y

CONFIG_CODEC_ES8311_SUPPORT=y
CONFIG_ESP_BOARD_DEV_CAMERA_SUPPORT=y

# Default display: Waveshare 10.1-DSI-TOUCH-A
CONFIG_BSP_LCD_TYPE_800_1280_10_1_INCH_A=y
CONFIG_BSP_LCD_COLOR_FORMAT_RGB565=y
CONFIG_BSP_LCD_DPI_BUFFER_NUMS=3
CONFIG_BSP_LCD_TYPE_AMENDS=n
# I2C backlight controller (0x45 / 0x96) implemented by lcd_brightness.c
CONFIG_BSP_LCD_BRIGHTNESS_USE_I2C=y

CONFIG_CAMERA_OV5647=y
CONFIG_CAMERA_OV5647_AUTO_DETECT_MIPI_INTERFACE_SENSOR=y
CONFIG_CAMERA_OV5647_MIPI_RAW8_800X1280_50FPS=y
CONFIG_CAMERA_OV5647_MIPI_DEFAULT_FMT_RAW8_800X1280_50FPS=y
CONFIG_CAMERA_OV5647_MIPI_IF_FORMAT_INDEX_DEFAULT=0
CONFIG_CAMERA_OV5647_CSI_LINESYNC_ENABLE=y
CONFIG_CAMERA_OV5647_DEFAULT_IPA_JSON_CONFIGURATION_FILE=y

CONFIG_PARTITION_TABLE_CUSTOM=y
```

## examples/esp_idf/07_i2s_codec/main/Kconfig.projbuild
```kconfig
menu "Example Configuration"

    choice EXAMPLE_MODE
        prompt "Example mode"
        default EXAMPLE_MODE_MUSIC
        help
            Select example work mode

        config EXAMPLE_MODE_MUSIC
            bool "music"
        config EXAMPLE_MODE_ECHO
            bool "echo"
    endchoice

    choice EXAMPLE_MIC_GAIN_SELECTION
        prompt "Microphone gain"
        default EXAMPLE_MIC_GAIN_24DB
        help
            Select the ES8311 microphone input gain in dB.
            This setting is used when opening or restoring the microphone codec.

        config EXAMPLE_MIC_GAIN_0DB
            bool "0 dB"
        config EXAMPLE_MIC_GAIN_6DB
            bool "6 dB"
        config EXAMPLE_MIC_GAIN_12DB
            bool "12 dB"
        config EXAMPLE_MIC_GAIN_18DB
            bool "18 dB"
        config EXAMPLE_MIC_GAIN_24DB
            bool "24 dB"
        config EXAMPLE_MIC_GAIN_30DB
            bool "30 dB"
        config EXAMPLE_MIC_GAIN_36DB
            bool "36 dB"
        config EXAMPLE_MIC_GAIN_42DB
            bool "42 dB"
    endchoice

    config EXAMPLE_MIC_GAIN_DB
        int
        default 0 if EXAMPLE_MIC_GAIN_0DB
        default 6 if EXAMPLE_MIC_GAIN_6DB
        default 12 if EXAMPLE_MIC_GAIN_12DB
        default 18 if EXAMPLE_MIC_GAIN_18DB
        default 24 if EXAMPLE_MIC_GAIN_24DB
        default 30 if EXAMPLE_MIC_GAIN_30DB
        default 36 if EXAMPLE_MIC_GAIN_36DB
        default 42 if EXAMPLE_MIC_GAIN_42DB

    config EXAMPLE_VOICE_VOLUME
        int "Voice volume"
        range 0 100
        default 60
        help
            Set voice volume
endmenu
```
